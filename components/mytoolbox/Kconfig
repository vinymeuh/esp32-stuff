## components/mytoolbox/Kconfig
```kconfig
menu "MY TOOLBOX"

menu "Wifi Station mode (STA)"

config MY_TOOLBOX_WIFI_STA_SSID
    string "Wifi SSID"
    help
        SSID of the network to connect to.

config MY_TOOLBOX_WIFI_STA_PASSWORD
    string "Wifi password"
    help
        Password of the network to connect to.

endmenu # "Wifi Station mode (STA)"

endmenu # "MY TOOLBOX"
```
